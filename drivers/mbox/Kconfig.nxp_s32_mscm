## drivers/mbox/Kconfig.nxp_s32_mscm
```kconfig
# Copyright The Zephyr Project Contributors
# SPDX-License-Identifier: Apache-2.0

config MBOX_NXP_S32_MSCM
	bool "NXP S32 MSCM core-to-core interrupt driver"
	default y
	depends on DT_HAS_NXP_S32_MSCM_MBOX_ENABLED
	help
	  Signalling-only mailbox driver on the core-to-core interrupts of the NXP S32K3
	  Miscellaneous System Control Module (MSCM).
```

## drivers/memc/Kconfig.nxp_s32_qspi
```kconfig
# Copyright 2023 NXP
# SPDX-License-Identifier: Apache-2.0

config MEMC_NXP_S32_QSPI
	bool "NXP S32 Quad Serial Peripheral Interface (QSPI) controller"
	default y
	depends on DT_HAS_NXP_S32_QSPI_ENABLED
	select PINCTRL
	help
	  Enable NXP S32 Quad Serial Peripheral Interface (QSPI) controller.

config MEMC_NXP_S32_QSPI_HYPERRAM
	bool "NXP S32 QSPI HyperRAM"
	default y
	depends on DT_HAS_NXP_S32_QSPI_HYPERRAM_ENABLED
	depends on MEMC_NXP_S32_QSPI
	help
	  HyperRAM on the NXP S32 QSPI controller, mapped as memory through the
	  controller's AHB window for reads and writes.

config MEMC_NXP_S32_QSPI_HYPERRAM_INIT_PRIORITY
	int "NXP S32 QSPI HyperRAM initialization priority"
	default 81 if MSPI
	default 1
	depends on MEMC_NXP_S32_QSPI_HYPERRAM
	help
	  Initialization priority of the HyperRAM, after its QSPI controller
	  (MEMC_INIT_PRIORITY).

config MEMC_NXP_S32_QSPI_HYPERRAM_NO_STREAMING_WRITES
	bool "Disable the core's streaming writes"
	default y
	depends on MEMC_NXP_S32_QSPI_HYPERRAM
	depends on CPU_CORTEX_M7
	help
	  Set ACTLR.DISRAMODE so memset/memcpy writes go through the data cache.
	  Contiguous AHB writes smaller than 32 bits stall the QSPI controller.
```

## dts/bindings/mbox/nxp,s32-mscm-mbox.yaml
```yaml
# Copyright The Zephyr Project Contributors
# SPDX-License-Identifier: Apache-2.0

description: |
  NXP S32K3 MSCM core-to-core interrupts as a mailbox

  The Miscellaneous System Control Module (MSCM) of the S32K3 lets a core raise one of
  four core-to-core interrupts in another core. Each channel of this mailbox is one of
  them: sending on channel N raises core-to-core interrupt N in the core set by
  remote-cpu, and the core-to-core interrupt N of the core running the image calls the
  callback registered for channel N. The channels carry no data (MTU 0), so it pairs
  with an IPC backend that keeps its data in shared memory, such as icmsg.

  Each core's image enables the node with the other core as remote-cpu, the logical
  processor number MSCM reports in CPXNUM (0 for Cortex-M7_0, 2 for Cortex-M7_2 on
  S32K358):

    // Cortex-M7_0
    &mscm {
      remote-cpu = <2>;
      status = "okay";
    };

compatible: "nxp,s32-mscm-mbox"

include: [base.yaml, mailbox-controller.yaml]

properties:
  reg:
    required: true

  interrupts:
    required: true
    description: Core-to-core interrupts 0 to 3 of the local core, in that order.

  remote-cpu:
    type: int
    required: true
    description: |
      Logical processor number (MSCM CPXNUM) of the core this mailbox sends to.

mbox-cells:
  - channel
```

## dts/bindings/mtd/nxp,s32-qspi-hyperram.yaml
```yaml
# Copyright The Zephyr Project Contributors
# SPDX-License-Identifier: Apache-2.0

description: |
  HyperRAM memory device on the NXP S32 QuadSPI controller.

  The device is accessed over HyperBus (8 data lines, DDR) through the controller's AHB
  window, which maps it as readable and writable memory. The controller samples read
  data with its pad loopback clock half a cycle early: it needs a-rx-clock-source =
  "LOOPBACK" and sample-delay-half-cycle.

  Write the AHB window through a cacheable mapping, or with 32-bit accesses: two
  address-contiguous AHB writes smaller than 32 bits stall the controller.

compatible: "nxp,s32-qspi-hyperram"

include: base.yaml

on-bus: qspi

properties:
  reg:
    required: true
    description: |
      Port the device is connected to: 0 for A1, 1 for A2, 2 for B1, 3 for B2.

  size:
    type: int
    required: true
    description: Memory size in bits.

  read-latency-cycles:
    type: int
    required: true
    description: |
      Initial latency, in clock cycles, as configured in the device (Configuration
      Register 0). The device must use fixed latency: the controller waits twice this
      count.
```

## soc/nxp/s32/s32k3/Kconfig
```kconfig
# NXP S32K3XX MCU series

# Copyright 2023-2024 NXP
# SPDX-License-Identifier: Apache-2.0

config SOC_SERIES_S32K3
	select ARM
	select CPU_CORTEX_M7
	select HAS_NXP_S32_HAL
	select CPU_HAS_FPU
	select CPU_HAS_ARM_MPU
	select CPU_HAS_ICACHE
	select CPU_HAS_DCACHE
	select CPU_HAS_CUSTOM_FIXED_SOC_MPU_REGIONS
	select SOC_EARLY_RESET_HOOK if XIP
	select USE_DT_CODE_PARTITION if XIP
	select CLOCK_CONTROL
	select HAS_MCUX
	select HAS_MCUX_CACHE
	select SOC_EARLY_INIT_HOOK
	select HAS_SEGGER_RTT if ZEPHYR_SEGGER_MODULE
	select SPI_NXP_LPSPI_ERR050456 if SPI_NXP_LPSPI

if SOC_SERIES_S32K3

config SOC_S32K3_IVT
	bool
	default y if XIP && (!BOOTLOADER_MCUBOOT || MCUBOOT) && !SOC_S32K358_CM7_2
	help
	  The image carries the image vector table the boot ROM starts the boot core from.
	  Images loaded by MCUboot and images for a core other than the boot core do not.

config SOC_S32K3_START_CM7_2
	bool "Start Cortex-M7_2"
	default y if $(dt_nodelabel_exists,cm7_2_code_partition)
	depends on SOC_S32K358_CM7_0
	help
	  Cortex-M7_0 starts Cortex-M7_2 at PRE_KERNEL_2, once the clock tree is configured,
	  from the vector table at the start of the cm7_2_code_partition partition. Linker
	  memory regions in system SRAM outside this image's SRAM (memory shared with
	  Cortex-M7_2, such as IPC buffers) are zeroed with 64-bit writes before, which
	  initializes their ECC.

config IVT_HEADER_OFFSET
	hex
	depends on SOC_S32K3_IVT
	default $(sub_hex,$(dt_node_reg_addr_int,$(dt_nodelabel_path,ivt_header)), \
		$(dt_chosen_reg_addr_int,$(DT_CHOSEN_Z_FLASH)))
	help
	  The offset address from flash base address for ivt header

config IVT_HEADER_SIZE
	hex
	depends on SOC_S32K3_IVT
	default $(dt_node_reg_size_hex,$(dt_nodelabel_path,ivt_header))
	help
	  Size of ivt header region

endif # SOC_SERIES_S32K3
```

## soc/nxp/s32/s32k3/Kconfig.soc
```kconfig
# NXP S32K3XX MCU series

# Copyright 2023-2024 NXP
# SPDX-License-Identifier: Apache-2.0

config SOC_SERIES_S32K3
	bool
	select SOC_FAMILY_NXP_S32

config SOC_SERIES
	default "s32k3" if SOC_SERIES_S32K3

config SOC_S32K344
	bool
	select SOC_SERIES_S32K3

config SOC_S32K348
	bool
	select SOC_SERIES_S32K3

config SOC_S32K358
	bool
	select SOC_SERIES_S32K3

config SOC_S32K358_CM7_0
	bool
	select SOC_S32K358
	help
	  S32K358 Cortex-M7_0, the lockstep core. It boots from the image vector table.

config SOC_S32K358_CM7_2
	bool
	select SOC_S32K358
	help
	  S32K358 Cortex-M7_2, the core outside the lockstep pair. It does not
	  boot from the image vector table: Cortex-M7_0 starts it.

config SOC
	default "s32k344" if SOC_S32K344
	default "s32k348" if SOC_S32K348
	default "s32k358" if SOC_S32K358

config SOC_PART_NUMBER_PS32K344EHVPBS
	bool

config SOC_PART_NUMBER
	default "PS32K344EHVPBS" if SOC_PART_NUMBER_PS32K344EHVPBS
```
